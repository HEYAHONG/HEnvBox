## tools/EnvCheck/Kconfig
```kconfig
menu "EnvCheck Kconfig"

config DISABLE_ENVCHECK_LOG
    bool "disable EnvCheck log"
    default y

endmenu
```

## tools/Linux/Kconfig
```kconfig
mainmenu "Linux Tool Config"

config HENVBOX_USE_KCONFIG
    bool "enable kconfig"
    default y

if HENVBOX_USE_KCONFIG

#导入EnvCheck的Kconfig配置
source "../EnvCheck/Kconfig"


config HENVBOX_TOOLS_PATH_PRIORITY_HIGH
    bool "high priority of HEnvBox tools"
    default n

endif
```

## tools/win32/Kconfig
```kconfig
mainmenu "Win32 Tool Config"

config HENVBOX_USE_KCONFIG
    bool "enable kconfig"
    default y
```
